VERSION ""

NS_ :

BS_:

BU_: ADC

BO_ 2147484688 SPI1_U09: 8 ADC
 SG_ OUT05 : 39|16@0+ (1,0) [0|65535] "" Vector__XXX
 SG_ OUT06 : 7|16@0+ (1,0) [0|65535] "" Vector__XXX

BO_ 2147484681 SPI1_U18: 8 ADC
 SG_ OUT17 : 39|16@0+ (1,0) [0|65535] "" Vector__XXX
 SG_ OUT18 : 7|16@0+ (1,0) [0|65535] "" Vector__XXX

BO_ 2147484680 SPI1_U07: 8 ADC
 SG_ OUT11 : 39|16@0+ (1,0) [0|65535] "" Vector__XXX
 SG_ OUT12 : 7|16@0+ (1,0) [0|65535] "" Vector__XXX

BO_ 2147484679 SPI1_U08: 8 ADC
 SG_ OUT10 : 39|16@0+ (1,0) [0|65535] "" Vector__XXX
 SG_ OUT09 : 7|16@0+ (1,0) [0|65535] "" Vector__XXX

BO_ 2147484678 SPI1_U16: 8 ADC
 SG_ OUT15 : 39|16@0+ (1,0) [0|65535] "" Vector__XXX
 SG_ OUT16 : 7|16@0+ (1,0) [0|65535] "" Vector__XXX

BO_ 2147484677 SPI0_U19: 8 ADC
 SG_ OUT19 : 39|16@0+ (1,0) [0|65535] "" Vector__XXX
 SG_ OUT20 : 7|16@0+ (1,0) [0|65535] "" Vector__XXX

BO_ 2147484676 SPI0_U05: 8 ADC
 SG_ OUT07 : 39|16@0+ (1,0) [0|65535] "" Vector__XXX
 SG_ OUT08 : 7|16@0+ (1,0) [0|65535] "" Vector__XXX

BO_ 2147484675 SPI0_U06: 8 ADC
 SG_ OUT03 : 39|16@0+ (1,0) [0|65535] "" Vector__XXX
 SG_ OUT04 : 7|16@0+ (1,0) [0|65535] "" Vector__XXX

BO_ 2147484674 SPI0_U04: 8 ADC
 SG_ OUT02 : 39|16@0+ (1,0) [0|65535] "" Vector__XXX
 SG_ OUT01 : 7|16@0+ (1,0) [0|65535] "" Vector__XXX

BO_ 2147484673 SPI0_U15: 8 ADC
 SG_ OUT13 : 39|16@0+ (1,0) [0|65535] "" Vector__XXX
 SG_ OUT14 : 7|16@0+ (1,0) [0|65535] "" Vector__XXX

BA_DEF_ SG_  "GenSigSendType" ENUM  "Cyclic","OnWrite","OnWriteWithRepetition","OnChange","OnChangeWithRepetition","IfActive","IfActiveWithRepetition","NoSigSendType";
BA_DEF_ BO_  "GenMsgSendType" ENUM  "Cyclic","not_used","not_used","not_used","not_used","Cyclic","not_used","IfActive","NoMsgSendType";
BA_DEF_  "DBName" STRING ;
BA_DEF_  "BusType" STRING ;
BA_DEF_DEF_  "GenSigSendType" "Cyclic";
BA_DEF_DEF_  "GenMsgSendType" "NoMsgSendType";
BA_DEF_DEF_  "DBName" "";
BA_DEF_DEF_  "BusType" "CAN";
BA_ "DBName" "adc_lc";
